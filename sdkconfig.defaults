## sdkconfig.defaults
```kconfig
# 控制台：UART0（各芯片默认引脚：S3=TX43/RX44，C3=TX21/RX20）
CONFIG_ESP_CONSOLE_UART_DEFAULT=y
CONFIG_ESP_CONSOLE_UART_NUM=0

# WiFi（仅 AP 模式，用于本地配置页面）+ PHY
CONFIG_ESP_WIFI_ENABLED=y
CONFIG_ESP_PHY_ENABLED=y
CONFIG_WPA_MBEDTLS_CRYPTO=y

# HTTP Server（配置页面）
CONFIG_ESP_HTTP_SERVER_ENABLE=y
CONFIG_HTTPD_MAX_REQ_HDR_LEN=1024   # 默认512，手机/浏览器请求头超长会报 431
CONFIG_HTTPD_MAX_URI_LEN=1024

# NVS Flash
CONFIG_NVS_FLASH_ENCRYPTION=n

# 日志级别
CONFIG_LOG_DEFAULT_LEVEL_INFO=y

# 分区表（单 app）
CONFIG_PARTITION_TABLE_SINGLE_APP=y

# 编译优化（减小体积）
CONFIG_COMPILER_OPTIMIZATION_SIZE=y
```

## sdkconfig.defaults.esp32s3
```kconfig
# ESP32-S3 target 专属配置（覆盖 sdkconfig.defaults）

# 用原生 USB（USB-Serial-JTAG Controller）作为 console。
# ESP-IDF 官方文档明确：只有选 CONFIG_ESP_CONSOLE_USB_SERIAL_JTAG，USB-Serial-JTAG 才接受输入
# （选 UART_DEFAULT 时 USB-Serial-JTAG 仅输出日志，收不到串口命令）。
# 串口 CLI 需要 USB 输入，故 S3 必须用 USB-Serial-JTAG 作 console。
CONFIG_ESP_CONSOLE_USB_SERIAL_JTAG=y
```
